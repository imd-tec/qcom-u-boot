// SPDX-License-Identifier: GPL-2.0+
/*
 * Copyright (C) 2019 Jagan Teki <jagan@amarulasolutions.com>
 */

#include "rk3399-u-boot.dtsi"
#include "rk3399-sdram-ddr3-1600.dtsi"

&sdmmc {
	max-frequency = <25000000>;  /* 25MHz for SD-wire compatibility */
	/delete-property/ cap-sd-highspeed;
	/delete-property/ cap-mmc-highspeed;
};

&vdd_log {
	regulator-init-microvolt = <950000>;
};
