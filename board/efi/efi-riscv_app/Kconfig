## board/efi/efi-riscv_app/Kconfig
```kconfig
# Copyright 2026 Canonical Ltd
# Written by Simon Glass <simon.glass@canonical.com>

if EFI_APP

config SYS_BOARD
	default "efi-riscv_app"

config SYS_VENDOR
	default "efi"

config SYS_SOC
	default "efi"

config SYS_CPU
	default "generic"

config BOARD_SPECIFIC_OPTIONS # dummy
	def_bool y
	select GENERIC_RISCV
	imply VIDEO_EFI

config SYS_LDSCRIPT
	default "arch/riscv/lib/elf_riscv64_efi_app.lds"

endif
```

## board/qualcomm/imdt-qcs8550/Kconfig
```kconfig
if TARGET_IMDT_QCS8550

config SYS_BOARD
	default "imdt-qcs8550"

config SYS_VENDOR
	default "qualcomm"

config SYS_SOC
	default "efi"

config SYS_LDSCRIPT
	default "arch/arm/lib/elf_aarch64_efi.lds"

config IMDT_QCS8550_OVERLAYS
	string "Default DT overlay list"
	default ""
	help
	  Space-separated list of DT overlay filenames (relative to /dtb on
	  the EFI boot partition) applied to the base DTB at boot. The list
	  becomes the default value of the 'overlays' environment variable
	  and can be overridden at runtime with setenv.

endif
```

## configs/qcom_imdt_qcs8550_defconfig
```kconfig
# Configuration for IMDT QCS8550 SBC
# Based on efi-arm_app64_defconfig with board-specific overrides
#include "efi-arm_app64_defconfig"
CONFIG_TARGET_IMDT_QCS8550=y
CONFIG_VIDEO=n
CONFIG_CHID=n
CONFIG_RUST_EXAMPLES=n
CONFIG_CONSOLE_PAGER=n
# Prevent serial terminals pausing the boot process due to unexpected input
CONFIG_AUTOBOOT_KEYED=y
CONFIG_AUTOBOOT_DELAY_STR="d"
CONFIG_AUTOBOOT_STOP_STR=" "
CONFIG_DEFAULT_FDT_FILE="qcs8550-imdt-sbc.dtb"
CONFIG_IMDT_QCS8550_OVERLAYS="qcs8550-imdt-sbc-display.dtbo qcs8550-imdt-sbc-ar1335-csi0.dtbo"
CONFIG_CMD_FDT=y
CONFIG_OF_LIBFDT_OVERLAY=y
CONFIG_ENV_IS_IN_FAT=y
CONFIG_ENV_FAT_INTERFACE="efi"
CONFIG_ENV_FAT_DEVICE_AND_PART="4:46"
CONFIG_ENV_SIZE=0x2000
# CONFIG_ENV_IS_DEFAULT is not set
# CONFIG_ENV_IS_NOWHERE is not set
CONFIG_BOOTCOUNT_LIMIT=y
CONFIG_BOOTCOUNT_ENV=y
```

## fs/ext4l/Kconfig
```kconfig
# SPDX-License-Identifier: GPL-2.0-only
#
# Copyright 2025 Canonical Ltd
# Written by Simon Glass <simon.glass@canonical.com>

config FS_EXT4L
	bool "Enable ext4 filesystem support (Linux port)"
	depends on FS
	select RBTREE
	select CRC32C
	help
	  This provides support for reading images from the ext4 filesystem,
	  using code ported from Linux. This is mutually exclusive with
	  FS_EXT4 (the existing U-Boot ext4 implementation).

	  This requires 64-bit LBA support for proper block counting.

config EXT4_JOURNAL
	bool "Enable ext4 journal support"
	depends on FS_EXT4L
	default y
	help
	  This enables journal (jbd2) support for ext4 filesystems. The
	  journal provides crash-consistency by logging metadata changes
	  before committing them to the filesystem.

	  If unsure, say Y.

config EXT4L_DEBUG
	bool "Enable ext4l debug messages"
	depends on FS_EXT4L
	default y if SANDBOX
	help
	  Enable debug and informational messages from the ext4l filesystem.
	  This includes mount messages, error details, and other ext4_msg()
	  output with full format strings.

	  Disabling this option replaces detailed error messages with generic
	  strings, saving about 20K of rodata. Mount failures will still be
	  reported but without specific details about what went wrong.

	  If unsure, say N.

config EXT4L_PRINT
	bool "Print ext4l messages to console"
	depends on EXT4L_DEBUG
	help
	  Print ext4l messages to the console in addition to recording them.
	  Messages are always recorded and can be retrieved programmatically;
	  this option controls whether they are also printed.

config EXT4_RESIZE
	bool "Enable ext4 online resize support"
	depends on FS_EXT4L
	help
	  Enable support for online filesystem resize. This allows
	  growing an ext4 filesystem while it is mounted.

	  This adds about 10K to the image size. Not needed for U-Boot
	  in most cases. If unsure, say N.

config EXT4_MIGRATE
	bool "Enable ext4 extent migration support"
	depends on FS_EXT4L
	help
	  Enable support for migrating inodes between indirect block
	  mapping and extent mapping formats.

	  This adds about 2.5K to the image size. Not needed for U-Boot
	  in most cases. If unsure, say N.

config EXT4_MOVE_EXTENT
	bool "Enable ext4 move extent ioctl support"
	depends on FS_EXT4L
	help
	  Enable support for the EXT4_IOC_MOVE_EXT ioctl which moves
	  extents between files.

	  This adds about 1.5K to the image size. Not needed for U-Boot.
	  If unsure, say N.

config EXT4_XATTR
	bool "Enable ext4 extended attributes support"
	depends on FS_EXT4L
	help
	  Enable support for extended attributes (xattrs) on ext4
	  filesystems. This is required for ACLs, security labels,
	  and user-defined attributes.

	  This adds about 14K to the image size. If unsure, say N.
```

## legacy_api/Kconfig
```kconfig
config LEGACY_API
	bool "Enable Legacy U-Boot API"
	depends on CC_IS_GCC
	help
	  This option enables the legcay U-Boot API. See legacy_api/README for
	  more information.

	  Note that this is deprecated and not intended to be used. It will be
	  removed by the end of 2027.

menu "LEGACY API"
	depends on LEGACY_API

config SYS_MMC_MAX_DEVICE
	int  "Maximum number of MMC devices exposed via the legacy API"
	default 1

endmenu
```
